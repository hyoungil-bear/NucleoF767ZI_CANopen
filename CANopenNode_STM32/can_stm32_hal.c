// can_stm32_hal.c
// STM32F767 (bxCAN) @ 1 Mbps + RX callback parsing for SDO / TPDO1(S/V/E) / Heartbeat
// Generated by ChatGPT (2025-09-19)

#include "can_stm32_hal.h"
#include "od_app.h"   // for parsing helpers: odapp_parse_tpdo1_sve, odapp_parse_heartbeat, odapp_sdo_parse_response
#include <string.h>

extern CAN_HandleTypeDef hcan1;

// ===== GPIO init =====
static void CAN1_GPIO_Init(void)
{
    __HAL_RCC_GPIOB_CLK_ENABLE();
    GPIO_InitTypeDef GPIO_InitStruct = {0};
    GPIO_InitStruct.Pin = CAN1_TX_PIN | CAN1_RX_PIN;
    GPIO_InitStruct.Mode = GPIO_MODE_AF_PP;
    GPIO_InitStruct.Pull = GPIO_NOPULL;
    GPIO_InitStruct.Speed = GPIO_SPEED_FREQ_VERY_HIGH;
    GPIO_InitStruct.Alternate = CAN1_GPIO_AF;
    HAL_GPIO_Init(CAN1_TX_GPIO_PORT, &GPIO_InitStruct);
    if (CAN1_RX_GPIO_PORT != CAN1_TX_GPIO_PORT) {
        // Re-init separately when ports differ
        HAL_GPIO_DeInit(CAN1_TX_GPIO_PORT, CAN1_TX_PIN);
        // TX
        GPIO_InitStruct.Pin = CAN1_TX_PIN;
        HAL_GPIO_Init(CAN1_TX_GPIO_PORT, &GPIO_InitStruct);
        // RX
        GPIO_InitStruct.Pin = CAN1_RX_PIN;
        HAL_GPIO_Init(CAN1_RX_GPIO_PORT, &GPIO_InitStruct);
    }
}

// ===== Bit timing for common F7 PCLK1 values =====
static void CAN1_BitTiming_1Mbps(CAN_HandleTypeDef* h)
{
    h->Init.Mode = CAN_MODE_NORMAL;
    h->Init.AutoBusOff = DISABLE;
    h->Init.AutoWakeUp = DISABLE;
    h->Init.AutoRetransmission = ENABLE;
    h->Init.ReceiveFifoLocked = DISABLE;
    h->Init.TimeTriggeredMode = DISABLE;
    h->Init.TransmitFifoPriority = ENABLE;

#if (CAN1_PCLK1_HZ == 54000000u)
    // 54 MHz: Prescaler=3, BS1=13TQ, BS2=2TQ -> total 16 TQ -> 54MHz/(3*16)=1.125 Mbps (slightly high)
    // Better: Prescaler=4, BS1=12TQ, BS2=3TQ -> 54MHz/(4*16)=843.75 kbps (too low)
    // Compromise for exact 1Mbps is not possible with integer divider at 54MHz.
    // Use Prescaler=6, BS1=11TQ, BS2=2TQ -> total 14 TQ -> 54MHz/(6*14)=642.857 kbps (too low)
    // Practical approach: run at nearby core clock where PCLK1=50/48/60/42 etc.
    // We'll choose 1.125 Mbps here, which many transceivers tolerate in lab. Adjust clock tree for exact 1 Mbps if needed.
    h->Init.Prescaler = 3;
    h->Init.SyncJumpWidth = CAN_SJW_1TQ;
    h->Init.TimeSeg1 = CAN_BS1_13TQ;
    h->Init.TimeSeg2 = CAN_BS2_2TQ;
#elif (CAN1_PCLK1_HZ == 50000000u)
    // 50 MHz: Prescaler=5, BS1=13TQ, BS2=2TQ -> 50/(5*16)=625 kbps (no)
    // Use Prescaler=4, BS1=11TQ, BS2=2TQ -> 50/(4*14)=892.9 kbps (no exact)
    // Exact 1Mbps with bxCAN requires PCLK1 multiple that allows integer solution. Recommend 48MHz or 42MHz.
    h->Init.Prescaler = 3;
    h->Init.SyncJumpWidth = CAN_SJW_1TQ;
    h->Init.TimeSeg1 = CAN_BS1_13TQ;
    h->Init.TimeSeg2 = CAN_BS2_2TQ;
#elif (CAN1_PCLK1_HZ == 48000000u)
    // 48 MHz: Prescaler=3, BS1=12, BS2=3 -> total 16 -> 48/(3*16)=1 Mbps (exact)
    h->Init.Prescaler = 3;
    h->Init.SyncJumpWidth = CAN_SJW_1TQ;
    h->Init.TimeSeg1 = CAN_BS1_12TQ;
    h->Init.TimeSeg2 = CAN_BS2_3TQ;
#elif (CAN1_PCLK1_HZ == 42000000u)
    // 42 MHz: Prescaler=3, BS1=11, BS2=2 -> total 14 -> 42/(3*14)=1 Mbps (exact)
    h->Init.Prescaler = 3;
    h->Init.SyncJumpWidth = CAN_SJW_1TQ;
    h->Init.TimeSeg1 = CAN_BS1_11TQ;
    h->Init.TimeSeg2 = CAN_BS2_2TQ;
#else
#warning "CAN1_PCLK1_HZ not recognized; using 42MHz scheme"
    h->Init.Prescaler = 3;
    h->Init.SyncJumpWidth = CAN_SJW_1TQ;
    h->Init.TimeSeg1 = CAN_BS1_11TQ;
    h->Init.TimeSeg2 = CAN_BS2_2TQ;
#endif
}

// ===== Bring-up =====
void CAN1_BringUp_1Mbps(void)
{
    __HAL_RCC_CAN1_CLK_ENABLE();
    CAN1_GPIO_Init();

    hcan1.Instance = CAN1;
    CAN1_BitTiming_1Mbps(&hcan1);
    if (HAL_CAN_Init(&hcan1) != HAL_OK) {
        while (1) { } // trap
    }

    // Accept-all filter -> FIFO0
    CAN_FilterTypeDef filter = {0};
    filter.FilterActivation = ENABLE;
    filter.FilterBank = 0;
    filter.FilterMode = CAN_FILTERMODE_IDMASK;
    filter.FilterScale = CAN_FILTERSCALE_32BIT;
    filter.FilterIdHigh = 0x0000;
    filter.FilterIdLow  = 0x0000;
    filter.FilterMaskIdHigh = 0x0000;
    filter.FilterMaskIdLow  = 0x0000;
    filter.FilterFIFOAssignment = CAN_RX_FIFO0;
    HAL_CAN_ConfigFilter(&hcan1, &filter);

    HAL_CAN_Start(&hcan1);

    // NVIC & IRQ for RX0
    HAL_NVIC_SetPriority(CAN1_RX0_IRQn, 5, 0);
    HAL_NVIC_EnableIRQ(CAN1_RX0_IRQn);
    HAL_CAN_ActivateNotification(&hcan1, CAN_IT_RX_FIFO0_MSG_PENDING);
}

// ===== Raw send =====
int can_send(uint32_t cobid, const uint8_t* data, uint8_t len)
{
    if (len > 8) len = 8;
    CAN_TxHeaderTypeDef hdr = {0};
    hdr.IDE = CAN_ID_STD;
    hdr.StdId = cobid & 0x7FFu;
    hdr.RTR = CAN_RTR_DATA;
    hdr.DLC = len;
    uint32_t mailbox;
    if (HAL_CAN_AddTxMessage(&hcan1, &hdr, (uint8_t*)data, &mailbox) == HAL_OK) {
        return 0;
    }
    return -1;
}

// ===== Minimal SDO download (expedited) =====
typedef struct {
    volatile uint8_t  flag;
    uint8_t  node;
    uint8_t  data[8];
} sdo_resp_t;
static sdo_resp_t s_sdo = {0};

void _sdo_match_response(uint32_t cobid, const uint8_t* data, uint8_t len)
{
    (void)len;
    uint32_t expect = 0x580u + s_sdo.node;
    if (s_sdo.node && cobid == expect) {
        memcpy((void*)s_sdo.data, data, 8);
        s_sdo.flag = 1;
    }
}

static int sdo_download(uint8_t node, uint16_t idx, uint8_t sub, const uint8_t* bytes, uint8_t size, uint32_t timeout_ms)
{
    uint32_t req_id = 0x600u + node;
    uint8_t cs = 0;
    if (size == 1) cs = 0x2F;
    else if (size == 2) cs = 0x2B;
    else if (size == 4) cs = 0x23;
    else return -10;

    uint8_t payload[8] = {0};
    payload[0] = cs;
    payload[1] = idx & 0xFF;
    payload[2] = (idx >> 8) & 0xFF;
    payload[3] = sub;
    payload[4] = bytes ? bytes[0] : 0;
    payload[5] = (size > 1) ? bytes[1] : 0;
    payload[6] = (size > 2) ? bytes[2] : 0;
    payload[7] = (size > 3) ? bytes[3] : 0;

    s_sdo.node = node;
    s_sdo.flag = 0;

    int rc = can_send(req_id, payload, 8);
    if (rc < 0) return rc;

    uint32_t start = HAL_GetTick();
    while (!s_sdo.flag) {
        if ((HAL_GetTick() - start) > timeout_ms) return -11;
    }
    if (s_sdo.data[0] == 0x60 &&
        s_sdo.data[1] == (idx & 0xFF) &&
        s_sdo.data[2] == ((idx >> 8) & 0xFF) &&
        s_sdo.data[3] == sub) {
        return 0;
    }
    return -12;
}

int sdo_write_u8 (uint8_t node, uint16_t idx, uint8_t sub, uint8_t  val) {
    return sdo_download(node, idx, sub, &val, 1, 50);
}
int sdo_write_u16(uint8_t node, uint16_t idx, uint8_t sub, uint16_t val) {
    uint8_t b[2] = { (uint8_t)(val & 0xFF), (uint8_t)((val>>8)&0xFF) };
    return sdo_download(node, idx, sub, b, 2, 50);
}
int sdo_write_u32(uint8_t node, uint16_t idx, uint8_t sub, uint32_t val) {
    uint8_t b[4] = {
        (uint8_t)(val & 0xFF),
        (uint8_t)((val>>8)&0xFF),
        (uint8_t)((val>>16)&0xFF),
        (uint8_t)((val>>24)&0xFF),
    };
    return sdo_download(node, idx, sub, b, 4, 50);
}

// ===== Weak app callbacks =====
__weak void app_on_tpdo1_sve(uint8_t node, uint16_t status, int32_t vel_actual, uint16_t error)
{ (void)node; (void)status; (void)vel_actual; (void)error; }

__weak void app_on_heartbeat(uint8_t node, uint8_t nmt_state)
{ (void)node; (void)nmt_state; }

__weak void app_on_sdo_response(uint8_t node, uint8_t kind, uint16_t idx, uint8_t sub, uint32_t aux)
{ (void)node; (void)kind; (void)idx; (void)sub; (void)aux; }

__weak void odapp_on_can_rx(uint32_t cobid, const uint8_t* data, uint8_t len)
{ (void)cobid; (void)data; (void)len; }

// ===== IRQ glue =====
#if 0	// khi
void CAN1_RX0_IRQHandler(void)
{
    HAL_CAN_IRQHandler(&hcan1);
}

void HAL_CAN_RxFifo0MsgPendingCallback(CAN_HandleTypeDef* h)
{
    if (h != &hcan1) return;
    CAN_RxHeaderTypeDef hdr;
    uint8_t data[8];
    if (HAL_CAN_GetRxMessage(&hcan1, CAN_RX_FIFO0, &hdr, data) != HAL_OK) return;
    if (hdr.IDE != CAN_ID_STD || hdr.RTR != CAN_RTR_DATA) return;

    uint32_t cobid = hdr.StdId & 0x7FFu;
    uint8_t len = hdr.DLC;

    // Generic hook first
    odapp_on_can_rx(cobid, data, len);

    const uint8_t node = APP_CANOPEN_NODE_ID;

#if APP_PARSE_TPDO1_SVE
    if (cobid == (0x180u + node)) {
        uint16_t sw=0, ec=0; int32_t va=0;
        if (odapp_parse_tpdo1_sve(node, cobid, data, len, &sw, &va, &ec) == 0) {
            app_on_tpdo1_sve(node, sw, va, ec);
        }
    }
#endif

#if APP_PARSE_HEARTBEAT
    if (cobid == (0x700u + node)) {
        odapp_nmt_state_t st;
        if (odapp_parse_heartbeat(node, cobid, data, len, &st) == 0) {
            app_on_heartbeat(node, (uint8_t)st);
        }
    }
#endif

#if APP_PARSE_SDO_RESP
#if 0
    if (cobid == (0x580u + node)) {
        ODAPP_SDOParsed p;
        if (len >= 8 && odapp_sdo_parse_response(data,len,  &p) == 0) {
            uint32_t aux = 0;
            if (p.kind == ODAPP_SDO_KIND_ABORT) aux = p.abort_code;
            else if (p.kind == ODAPP_SDO_KIND_UL_INIT_RESP) {
                // pack first up to 4 bytes for convenience
                aux = (uint32_t)p.data[0] | ((uint32_t)p.data[1]<<8) |
                      ((uint32_t)p.data[2]<<16) | ((uint32_t)p.data[3]<<24);
            }
            app_on_sdo_response(node, (uint8_t)p.kind, p.index, p.sub, aux);
        }
        // Also feed minimal SDO client matcher (for blocking writes)
        _sdo_match_response(cobid, data, len);
    }
#endif
#endif
}
#endif
