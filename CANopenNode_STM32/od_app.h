// od_app.h - Velocity-mode setup, PDO remapping & NMT helpers
// Generated by ChatGPT (2025-09-19)
#pragma once

#include <stdint.h>
#include <stdbool.h>

#ifndef ODAPP_DELAY_MS
#define ODAPP_DELAY_MS(ms) do { (void)(ms); } while(0)
#endif

#include "od_common.h"

#ifdef __cplusplus
extern "C" {
#endif

// ===== User-provided CANopen stack hooks (must be implemented in your project) =====
int sdo_write_u8 (uint8_t node, uint16_t idx, uint8_t sub, uint8_t  val);
int sdo_write_u16(uint8_t node, uint16_t idx, uint8_t sub, uint16_t val);
int sdo_write_u32(uint8_t node, uint16_t idx, uint8_t sub, uint32_t val);

// CAN raw send
int can_send(uint32_t cobid, const uint8_t* data, uint8_t len);

// ===== NMT =====
typedef enum {
    ODAPP_NMT_BOOT           = 0x00,
    ODAPP_NMT_STOPPED        = 0x04,
    ODAPP_NMT_OPERATIONAL    = 0x05,
    ODAPP_NMT_PREOP          = 0x7F,
} odapp_nmt_state_t;

typedef enum {
    ODAPP_NMT_CMD_START_NODE      = 0x01,
    ODAPP_NMT_CMD_STOP_NODE       = 0x02,
    ODAPP_NMT_CMD_ENTER_PREOP     = 0x80,
    ODAPP_NMT_CMD_RESET_NODE      = 0x81,
    ODAPP_NMT_CMD_RESET_COMM      = 0x82,
} odapp_nmt_cmd_t;

// Send generic NMT command to a node (node=0 for broadcast)
int odapp_nmt_send(uint8_t node, odapp_nmt_cmd_t cmd);

// Convenience wrappers
static inline int odapp_nmt_start(uint8_t node)     { return odapp_nmt_send(node, ODAPP_NMT_CMD_START_NODE); }
static inline int odapp_nmt_stop(uint8_t node)      { return odapp_nmt_send(node, ODAPP_NMT_CMD_STOP_NODE); }
static inline int odapp_nmt_preop(uint8_t node)     { return odapp_nmt_send(node, ODAPP_NMT_CMD_ENTER_PREOP); }
static inline int odapp_nmt_reset_node(uint8_t node){ return odapp_nmt_send(node, ODAPP_NMT_CMD_RESET_NODE); }
static inline int odapp_nmt_reset_comm(uint8_t node){ return odapp_nmt_send(node, ODAPP_NMT_CMD_RESET_COMM); }
// Broadcast to all nodes
static inline int odapp_nmt_start_all(void)         { return odapp_nmt_send(0x00, ODAPP_NMT_CMD_START_NODE); }
static inline int odapp_nmt_stop_all(void)          { return odapp_nmt_send(0x00, ODAPP_NMT_CMD_STOP_NODE); }

// Parse heartbeat (0x700 + node). Returns 0 on success; -1 if cobid mismatch; -2 if len<1.
int odapp_parse_heartbeat(uint8_t node, uint32_t cobid, const uint8_t* data, uint8_t len,
                          odapp_nmt_state_t* out_state);

// Configure Producer Heartbeat Time (0x1017:00, ms). 0 disables producer heartbeat.

// ===== Watchdog / Guarding / Heartbeat control =====

// ===== Regenerative brake resistor (chopper) =====
// Some drives expose a vendor-specific parameter for the DC-bus brake chopper turn-on threshold (mV).
// The uploaded EDS files (ISV2-CAN, Kinco FD) do not specify a standard object for this.
// To enable this API, define the following macros to match your device before including this header:
//   #define ODAPP_IDX_REGEN_THRESHOLD     0xFFFF  // Replace with vendor index (e.g., 0x6412)
//   #define ODAPP_SUB_REGEN_THRESHOLD     0x00    // Replace with vendor subindex
//   // Select write width (one of):
//   // #define ODAPP_REGEN_THRESHOLD_U16
//   // #define ODAPP_REGEN_THRESHOLD_U32
//
// Optionally, if the drive requires an explicit enable switch for the brake chopper:
//   #define ODAPP_IDX_REGEN_ENABLE        0xFFFF
//   #define ODAPP_SUB_REGEN_ENABLE        0x00
//   // Value to enable/disable (device-specific):
//   #define ODAPP_REGEN_ENABLE_ON_VALUE   1
//   #define ODAPP_REGEN_ENABLE_OFF_VALUE  0
//
// API:
int odapp_set_regen_threshold_mv(uint8_t node, uint32_t millivolts);
int odapp_set_regen_enable(uint8_t node, bool enable);

// Disable Node Guarding (0x100C=0, 0x100D=0), disable heartbeat producer (0x1017=0),
// and clear consumer heartbeat entries (0x1016:00=0). Returns 0 on success.
int odapp_disable_watchdogs(uint8_t node);

// Individually controllable pieces:
int odapp_disable_node_guarding(uint8_t node);  // 0x100C=0, 0x100D=0
int odapp_disable_heartbeat(uint8_t node);      // 0x1017=0 and 0x1016:00=0 (best effort)

int odapp_set_producer_heartbeat(uint8_t node, uint16_t period_ms);

// ===== Encoder pulses-per-rev =====
// Set encoder/feedback counts per mechanical revolution (CPR).
// Best-effort: tries CiA 402 standard 0x608F:01 (encoder increments), then Kinco 0x6410:03 (Motor Feedback Resolution).
// Returns 0 on success; <0 if both attempts fail.
int odapp_set_counts_per_rev(uint8_t node, uint32_t counts_per_rev);

// ===== RPDO 10ms support =====
// Configure RPDO1 as synchronous (TT=1) with only Target velocity (0x60FF:00) mapped.
// Leaves TPDOs untouched; combine with odapp_configure_pdo_vel_profile_10ms if needed.
int odapp_configure_rpdo1_sync_10ms(uint8_t node);

// Send only Target velocity via RPDO1 (mapping: 0x60FF only).
int odapp_set_target_velocity_rpdo(uint8_t node, int32_t target_vel_counts_per_s);

// Send a SYNC (COB-ID 0x80). Typically call every 10 ms when using synchronous PDOs.
int odapp_sync_send(void);

// Convenience: one 10ms cycle for synchronous control
// (1) send RPDO1 target velocity, then (2) send SYNC.
int odapp_cycle_10ms_sync(uint8_t node, int32_t target_vel_counts_per_s);


// ===== Acceleration / Deceleration (CiA-402) =====
// Units: counts/s^2. For velocity-mode ramps, set 0x6083 (accel) and 0x6084 (decel).
// Optional quick-stop decel (0x6085).

int odapp_set_profile_accel(uint8_t node, uint32_t accel_counts_per_s2);      // 0x6083:00
int odapp_set_profile_decel(uint8_t node, uint32_t decel_counts_per_s2);      // 0x6084:00
int odapp_set_quick_stop_decel(uint8_t node, uint32_t qstop_counts_per_s2);   // 0x6085:00

// Convenience: set both accel/decel together (quick stop optional: pass 0 to skip)
int odapp_set_profile_accdec(uint8_t node, uint32_t accel_counts_per_s2,
                             uint32_t decel_counts_per_s2, uint32_t qstop_counts_per_s2);

// ===== Unit helpers =====
// Convert acceleration specified as rpm/s to counts/s^2
static inline uint32_t odapp_accel_counts_per_s2_from_rpmps(uint32_t rpm_per_sec, uint32_t counts_per_rev) {
    // counts/s^2 = (rpm/s) * (counts/rev) / 60
    // beware of overflow; compute in 64-bit and clamp
    uint64_t num = (uint64_t)rpm_per_sec * (uint64_t)counts_per_rev;
    uint64_t v = num / 60u;
    if (v > 0xFFFFFFFFu) v = 0xFFFFFFFFu;
    return (uint32_t)v;
}


// ===== High-level startup sequence (per provided flow) =====
// Steps:
// 1) NMT - Reset Nodes (broadcast)        -> odapp_nmt_reset_node(0)
// 2) NMT - Active Node (Start)            -> odapp_nmt_start(node)
// 3) Max torque set                       -> 0x6072:00 (0.1% units)
// 4) Operation Mode Set (Profile Velocity)-> 0x6060:00 = 3
// 5) Acceleration & Deceleration Set      -> 0x6083 / 0x6084 (and optional 0x6085)
// 6) Control Word Set (Run/QuickStop Off/Circuit PowerON/Start) -> odapp_servo_enable(node)
int odapp_set_max_torque_percent(uint8_t node, uint16_t percent_0_to_100);       // writes 0x6072:00 = percent*10
int odapp_set_mode_profile_velocity(uint8_t node);                                // writes 0x6060:00 = 3
int odapp_run_sequence_profile_velocity(uint8_t node,
                                        uint16_t max_torque_percent,             // 0..100 (%)
                                        uint32_t accel_counts_per_s2,
                                        uint32_t decel_counts_per_s2,
                                        uint32_t qstop_counts_per_s2);           // 0 to skip

// ===== Velocity-mode & PDO remapping =====

// Configure: RPDO1=Target velocity; TPDO1=Statusword+Velocity actual+Error code @10ms; other PDOs disabled.
// - RPDO1 COB-ID: 0x200+node, map: 0x60FF:00 (32)
// - TPDO1 COB-ID: 0x180+node, map: 0x6041:00 (16), 0x606C:00 (32), 0x603F:00 (16)
// - TPDO1 event timer: 10 ms (sub5=10), transmission type=255 (async)
// - Disable RPDO/TPDO 2..4 (set COB-ID bit31 and clear mapping counts)
// Returns 0 on success (best-effort ignores non-existing indices).
int odapp_configure_pdo_vel_profile_10ms(uint8_t node);

int odapp_configure_velocity_mode(uint8_t node);
int odapp_enable_operation(uint8_t node);
int odapp_set_profile_params(uint8_t node, uint32_t accel_cps2, uint32_t decel_cps2, uint32_t prof_vel_cps);
int odapp_set_velocity(uint8_t node, int32_t target_vel_counts_per_s, uint16_t controlword);
int odapp_parse_tpdo1(uint8_t node, uint32_t cobid, const uint8_t* data, uint8_t len,
                      uint16_t* out_status, int32_t* out_vel_actual);
// ===== Servo enable/disable helpers =====
// High-level "servo ON": run DS402 sequence to Operation Enabled.
int odapp_servo_enable(uint8_t node);
// Disable only "operation enabled" (stay in Switched On).
int odapp_servo_disable_operation(uint8_t node);
// Disable voltage (go to Switch On Disabled).
int odapp_servo_disable_voltage(uint8_t node);
// Quick stop (bit2=0); device executes vendor-defined quick stop behavior.
int odapp_servo_quick_stop(uint8_t node);

// If RPDO1 is mapped (6040 first), you can toggle controlword via PDO.
// This sends 0 velocity with the given controlword.
int odapp_servo_set_controlword_rpdo(uint8_t node, uint16_t controlword);



// ===== Encoder counts-per-rev (CPR) configuration =====
// Set counts-per-revolution via standard CiA-402 objects when available.
// Primary: 0x608F:01 (encoder increments) = counts_per_rev, 0x608F:02 = 1
// Fallback (vendor-specific for some drives, e.g., Kinco): 0x2508:01 (Gear Factor) = counts_per_rev, 0x2508:02 (Gear Devider) = 1
int odapp_set_cpr(uint8_t node, uint32_t counts_per_rev);
static inline int odapp_set_cpr_10000(uint8_t node) { return odapp_set_cpr(node, 10000u); }


// ===== EEPROM / parameter storage (CiA 301: 0x1010/0x1011) =====
typedef enum {
    ODAPP_STORE_ALL          = 1, // 0x1010:01
    ODAPP_STORE_COMM         = 2, // 0x1010:02
    ODAPP_STORE_APP          = 3, // 0x1010:03
    ODAPP_STORE_MANUFACTURER = 4  // 0x1010:04
} odapp_store_area_t;

// Store parameters to non-volatile memory (EEPROM/Flash) using 0x1010:sub = "save".
// Returns 0 on success; <0 on SDO error.
// Note: some devices may take time and/or reset after storing.
int odapp_store_params(uint8_t node, odapp_store_area_t area);
int odapp_store_params_all(uint8_t node);   // helper: area=ALL
int odapp_store_params_comm(uint8_t node);  // helper: area=COMM
int odapp_store_params_app(uint8_t node);   // helper: area=APP
int odapp_store_params_manu(uint8_t node);  // helper: area=MANUFACTURER

// Restore parameters to factory defaults using 0x1011:sub = "load".
// Returns 0 on success; <0 on SDO error.
int odapp_restore_defaults(uint8_t node, odapp_store_area_t area);
int odapp_restore_defaults_all(uint8_t node);


// ===== Alarm/Fault reset & Error code parsing =====

// Recover from fault: Fault Reset -> Shutdown -> Switch On -> Enable Operation
// Best-effort clears error log (0x1003:00=0). Returns 0 on success.
int odapp_recover_from_fault(uint8_t node);


// Fault/Alarm reset (CiA-402): Controlword bit7 pulse (0x0080).
// Typical flow after reset: go to Shutdown(0x0006) -> Switch On(0x0007) -> Enable Operation(0x000F).
int odapp_fault_reset(uint8_t node);
static inline int odapp_alarm_reset(uint8_t node) { return odapp_fault_reset(node); }

// Clear Pre-defined Error Field (0x1003) log (sub0=0).
int odapp_clear_error_log(uint8_t node);

// Read current Error Code (0x603F:00, UNSIGNED16).
int odapp_read_error_code(uint8_t node, uint16_t* out_code);

// Convert 0x603F code to human-readable class/description (best-effort, CiA-301 common set).
const char* odapp_error_class_str(uint16_t code);
const char* odapp_error_desc_str(uint16_t code);

// Debug helper: print one line summary
void odapp_print_error(uint16_t code);


// ===== SDO response parsing (generic) =====
typedef enum {
    ODAPP_SDO_RESP_UNKNOWN = 0,
    ODAPP_SDO_RESP_DL_INIT_ACK,   // 0x60 Download response
    ODAPP_SDO_RESP_UL_INIT_ACK,   // 0x4? Upload initiate response (expedited or size-indicated)
    ODAPP_SDO_RESP_ABORT         // 0x80 Abort transfer
} odapp_sdo_resp_type_t;

typedef struct {
    odapp_sdo_resp_type_t type;
    uint8_t  cs_raw;         // data[0]
    uint16_t index;          // data[1..2], little-endian
    uint8_t  sub;
    // Upload expedited fields
    uint8_t  expedited;      // bit1
    uint8_t  size_indicated; // bit0
    uint8_t  n_unused;       // bits 2..3 (0..3)
    uint8_t  data_len;       // 0..4 (for expedited)
    uint8_t  data[4];
    // Abort
    uint32_t abort_code;     // data[4..7], if type==ABORT
} ODAPP_SDOParsed;

// Parse raw 8-byte SDO response payload into ODAPP_SDOParsed.
// Returns 0 on success; <0 on length/format errors.
int odapp_sdo_parse_response(const uint8_t* data, uint8_t len, ODAPP_SDOParsed* out);

// Convert SDO abort code (0x80 frames data[4..7]) to human-readable text.
const char* odapp_sdo_abort_str(uint32_t code);

// Debug print helper
void odapp_sdo_print_parsed(const ODAPP_SDOParsed* p);

// ===== Generic PDO parsing helpers =====
// Mapping entry helpers (CiA-301): 0xIIII SS LL  -> index I, sub S, length bits L
#ifndef ODAPP_MAP_IDX
#define ODAPP_MAP_IDX(m)   (uint16_t)(((m) >> 16) & 0xFFFFu)
#endif
#ifndef ODAPP_MAP_SUB
#define ODAPP_MAP_SUB(m)   (uint8_t) (((m) >>  8) & 0xFFu)
#endif
#ifndef ODAPP_MAP_BITS
#define ODAPP_MAP_BITS(m)  (uint8_t) ((m)        & 0xFFu)
#endif

// Parse PDO payload according to 'map' (map_count entries).
// Supports byte-aligned entries only (8/16/32/64 bit). Values returned little-endian in out_vals[].
// Returns 0 on success; <0 on error (len mismatch, non-byte-aligned, etc).
int odapp_pdo_parse_values(const uint8_t* data, uint8_t len,
                           const uint32_t* map, uint8_t map_count,
                           uint64_t* out_vals);

// Convenience: scan 'map' to find the Nth occurrence of (index,sub) and return its value as 16/32.
// Returns 0 on success; <0 if not found or size mismatch.
int odapp_pdo_get_u16(const uint8_t* data, uint8_t len,
                      const uint32_t* map, uint8_t map_count,
                      uint16_t index, uint8_t sub, uint16_t* out);

int odapp_pdo_get_u32(const uint8_t* data, uint8_t len,
                      const uint32_t* map, uint8_t map_count,
                      uint16_t index, uint8_t sub, uint32_t* out);

// Specialized TPDO1 parser (Statusword + Velocity actual + Error code)
// Mapping assumed: 0x6041:00 (16), 0x606C:00 (32), 0x603F:00 (16).
// Returns 0 on success; -1 COB-ID mismatch; -2 length too small.
int odapp_parse_tpdo1_sve(uint8_t node, uint32_t cobid, const uint8_t* data, uint8_t len,
                          uint16_t* out_status, int32_t* out_vel_actual, uint16_t* out_error);

// ===== Unit helpers =====

// ===== Device info / firmware version =====
typedef struct {
    uint32_t device_type;      // 0x1000:00 (U32)
    uint8_t  error_register;   // 0x1001:00 (U8)
    uint32_t vendor_id;        // 0x1018:01 (U32)
    uint32_t product_code;     // 0x1018:02 (U32)
    uint32_t revision;         // 0x1018:03 (U32)
    uint32_t serial;           // 0x1018:04 (U32)
    char     device_name[32];  // 0x1008 (best-effort, expedited only)
    char     hw_version[32];   // 0x1009 (best-effort, expedited only)
    char     sw_version[32];   // 0x100A (best-effort, expedited only)
} ODAPP_DeviceInfo;

// Read standard device info objects into struct. Strings use expedited SDO only.
// Returns 0 on success (numeric fields); string fields may be empty if segmented transfer is required.
int odapp_read_device_info(uint8_t node, ODAPP_DeviceInfo* out);

// Convenience: print to stdout
void odapp_print_device_info(const ODAPP_DeviceInfo* info);


static inline int32_t odapp_rpm_to_counts_per_s(int32_t rpm, uint32_t counts_per_rev) {
    int64_t tmp = (int64_t)rpm * (int64_t)counts_per_rev;
    tmp /= 60;
    if (tmp > INT32_MAX) tmp = INT32_MAX;
    if (tmp < INT32_MIN) tmp = INT32_MIN;
    return (int32_t)tmp;
}

static inline int32_t odapp_counts_per_s_to_rpm(int32_t cps, uint32_t counts_per_rev) {
    int64_t tmp = (int64_t)cps * 60;
    if (counts_per_rev) tmp /= (int64_t)counts_per_rev;
    if (tmp > INT32_MAX) tmp = INT32_MAX;
    if (tmp < INT32_MIN) tmp = INT32_MIN;
    return (int32_t)tmp;
}

#ifdef __cplusplus
} // extern "C"
#endif
