// od_app.c - Velocity-mode setup, PDO remapping & NMT helpers
// Generated by ChatGPT (2025-09-19)

#include "od_app.h"
#include <stdio.h>
#include <string.h>

#ifndef ODAPP_LOG
#define ODAPP_LOG(fmt, ...)   do { printf("[od_app] " fmt "\n", ##__VA_ARGS__); } while(0)
#endif

#define MAP_ENTRY(idx, sub, lenbits) ( ((uint32_t)(idx)<<16) | ((uint32_t)(sub)<<8) | (uint32_t)(lenbits) )

static inline uint32_t odapp_rpdo1_cobid(uint8_t node) { return 0x200u + (uint32_t)node; }
static inline uint32_t odapp_tpdo1_cobid(uint8_t node) { return 0x180u + (uint32_t)node; }

// ===== NMT =====
int odapp_nmt_send(uint8_t node, odapp_nmt_cmd_t cmd)
{
    uint8_t payload[2];
    payload[0] = (uint8_t)cmd;   // NMT command
    payload[1] = node;           // node ID (0x00 = broadcast)
    // NMT uses CAN base ID 0x000, 2 data bytes
    int rc = can_send(0x000, payload, 2);
    if (rc >= 0) {
        ODAPP_LOG("NMT cmd=0x%02X sent to node=0x%02X", (unsigned)cmd, (unsigned)node);
        return 0;
    }
    return rc;
}

int odapp_parse_heartbeat(uint8_t node, uint32_t cobid, const uint8_t* data, uint8_t len,
                          odapp_nmt_state_t* out_state)
{
    if (cobid != (0x700u + (uint32_t)node)) return -1;
    if (len < 1) return -2;
    if (out_state) *out_state = (odapp_nmt_state_t)data[0];
    return 0;
}

int odapp_set_producer_heartbeat(uint8_t node, uint16_t period_ms)
{
    // 0x1017:00 Producer Heartbeat Time (UNSIGNED16, ms)
    return sdo_write_u16(node, 0x1017, 0x00, period_ms);
}

int odapp_disable_node_guarding(uint8_t node)
{
    // 0x100C: Guard Time (UNSIGNED16), 0x100D: Life Time Factor (UNSIGNED8)
    int rc = 0;
    if ((rc = sdo_write_u16(node, 0x100C, 0x00, 0)) < 0) return rc;
    if ((rc = sdo_write_u8 (node, 0x100D, 0x00, 0)) < 0) return rc;
    ODAPP_LOG("Node guarding disabled (node=0x%02X)", node);
    return 0;
}

int odapp_disable_heartbeat(uint8_t node)
{
    int rc = 0;
    // Disable producer heartbeat (0x1017:00 = 0)
    if ((rc = sdo_write_u16(node, 0x1017, 0x00, 0)) < 0) return rc;

    // Clear consumer heartbeat entries: 0x1016:00 = 0
    // Not all devices implement 0x1016; ignore error if unsupported.
    rc = sdo_write_u8(node, 0x1016, 0x00, 0);
    if (rc < 0) {
        ODAPP_LOG("Consumer heartbeat (0x1016) not supported or write failed (node=0x%02X), continuing", node);
        rc = 0; // best-effort
    } else {
        // Optionally clear a few entries; ignore errors
        for (uint8_t si = 1; si <= 4; ++si) {
            (void)sdo_write_u32(node, 0x1016, si, 0);
        }
    }

    ODAPP_LOG("Heartbeat disabled (producer=0, consumer cleared) for node=0x%02X", node);
    return 0;
}

int odapp_disable_watchdogs(uint8_t node)
{
    int rc = 0;
    if ((rc = odapp_disable_node_guarding(node)) < 0) return rc;
    if ((rc = odapp_disable_heartbeat(node)) < 0) return rc;
    return 0;
}

// ===== Regenerative brake resistor (chopper) =====
int odapp_set_regen_threshold_mv(uint8_t node, uint32_t millivolts)
{
#if defined(ODAPP_IDX_REGEN_THRESHOLD) && defined(ODAPP_SUB_REGEN_THRESHOLD)
    int rc = 0;
    #if defined(ODAPP_REGEN_THRESHOLD_U16)
        if (millivolts > 0xFFFFu) millivolts = 0xFFFFu;
        rc = sdo_write_u16(node, ODAPP_IDX_REGEN_THRESHOLD, ODAPP_SUB_REGEN_THRESHOLD, (uint16_t)millivolts);
    #elif defined(ODAPP_REGEN_THRESHOLD_U32)
        rc = sdo_write_u32(node, ODAPP_IDX_REGEN_THRESHOLD, ODAPP_SUB_REGEN_THRESHOLD, (uint32_t)millivolts);
    #else
        #error "Define ODAPP_REGEN_THRESHOLD_U16 or ODAPP_REGEN_THRESHOLD_U32 to choose write width"
    #endif
    if (rc >= 0) {
        ODAPP_LOG("Regen threshold set to %u mV (idx=0x%04X:%u)", (unsigned)millivolts, (unsigned)ODAPP_IDX_REGEN_THRESHOLD, (unsigned)ODAPP_SUB_REGEN_THRESHOLD);
        return 0;
    }
    return rc;
#else
    // Not supported without vendor index/sub definition
    ODAPP_LOG("Regen threshold not configured (define ODAPP_IDX_REGEN_THRESHOLD/ODAPP_SUB_REGEN_THRESHOLD)");
    return -100;
#endif
}

int odapp_set_regen_enable(uint8_t node, bool enable)
{
#if defined(ODAPP_IDX_REGEN_ENABLE) && defined(ODAPP_SUB_REGEN_ENABLE) && \
    defined(ODAPP_REGEN_ENABLE_ON_VALUE) && defined(ODAPP_REGEN_ENABLE_OFF_VALUE)
    uint8_t val = enable ? (uint8_t)ODAPP_REGEN_ENABLE_ON_VALUE : (uint8_t)ODAPP_REGEN_ENABLE_OFF_VALUE;
    int rc = sdo_write_u8(node, ODAPP_IDX_REGEN_ENABLE, ODAPP_SUB_REGEN_ENABLE, val);
    if (rc >= 0) {
        ODAPP_LOG("Regen chopper %s (idx=0x%04X:%u)", enable ? "ENABLED" : "DISABLED",
                  (unsigned)ODAPP_IDX_REGEN_ENABLE, (unsigned)ODAPP_SUB_REGEN_ENABLE);
        return 0;
    }
    return rc;
#else
    ODAPP_LOG("Regen enable not configured (define ODAPP_IDX_REGEN_ENABLE/ODAPP_SUB_REGEN_ENABLE/ON_VALUE/OFF_VALUE)");
    return -101;
#endif
}


// ===== Encoder pulses-per-rev =====
int odapp_set_counts_per_rev(uint8_t node, uint32_t counts_per_rev)
{
    // Try CiA-402 standard object first: 0x608F:01 (encoder increments)
    int rc = sdo_write_u32(node, 0x608F, 0x01, counts_per_rev);
    if (rc >= 0) {
        ODAPP_LOG("Set 0x608F:01 (encoder increments) = %u for node=0x%02X", (unsigned)counts_per_rev, node);
        return 0;
    }

    // Try Kinco vendor object: 0x6410:03 (Motor Feedback Resolution)
    rc = sdo_write_u32(node, 0x6410, 0x03, counts_per_rev);
    if (rc >= 0) {
        ODAPP_LOG("Set 0x6410:03 (Motor Feedback Resolution) = %u for node=0x%02X", (unsigned)counts_per_rev, node);
        return 0;
    }

    // If the drive uses different objects, extend here as needed.
    return rc;
}

/* RPDO/TPDO 비활성화 헬퍼들 (CiA 301 규칙: COB-ID bit31=1) */
static inline int disable_rpdo(uint8_t node, uint16_t base) {
    /* base: 0x1400 + n */
    int r = 0;
    uint16_t n = (uint16_t)(base - 0x1400u);
    /* RPDOn COB-ID = 0x200 + n*0x100 + node */
    uint32_t cob = (uint32_t)(0x200u + ((uint32_t)n * 0x100u) + (uint32_t)node);
    r |= sdo_write_u32(node, base,   0x01u, 0x80000000u | cob);     /* 비활성화 */
    /* 매핑 클리어: 0x1600 + n, sub 0x00 = 0 */
    r |= sdo_write_u8 (node, (uint16_t)(0x1600u + n), 0x00u, 0u);
    return r;
}

static inline int disable_tpdo(uint8_t node, uint16_t base) {
    /* base: 0x1800 + n */
    int r = 0;
    uint16_t n = (uint16_t)(base - 0x1800u);
    /* TPDOn COB-ID = 0x180 + n*0x100 + node */
    uint32_t cob = (uint32_t)(0x180u + ((uint32_t)n * 0x100u) + (uint32_t)node);
    r |= sdo_write_u32(node, base,   0x01u, 0x80000000u | cob);     /* 비활성화 */
    /* 매핑 클리어: 0x1A00 + n, sub 0x00 = 0 */
    r |= sdo_write_u8 (node, (uint16_t)(0x1A00u + n), 0x00u, 0u);
    return r;
}

// Configure: RPDO1=Target velocity; TPDO1=Statusword+Velocity actual+Error code @10ms; disable others
int odapp_configure_pdo_vel_profile_10ms(uint8_t node)
{
    int rc = 0;
    uint16_t i;

    /* 0) 리맵 동안 RPDO/TPDO 1..4 비활성화 */
    for (i = 0; i < 4u; ++i) {
        (void)disable_rpdo(node, (uint16_t)(0x1400u + i));
        (void)disable_tpdo(node, (uint16_t)(0x1800u + i));
    }

    /* 1) RPDO1 매핑: 0x60FF:00 (Target velocity, 32-bit) */
    rc = sdo_write_u8 (node, 0x1600u, 0x00u, 0u);                                   if (rc < 0) return rc;
    rc = sdo_write_u32(node, 0x1600u, 0x01u, MAP_ENTRY(0x60FF, 0x00, 32));          if (rc < 0) return rc;
    rc = sdo_write_u8 (node, 0x1600u, 0x00u, 1u);                                   if (rc < 0) return rc;
    /* RPDO1 통신: COB-ID=0x200+node, 전송타입(TT)=255 */
    rc = sdo_write_u32(node, 0x1400u, 0x01u, (uint32_t)(0x200u + (uint32_t)node));  if (rc < 0) return rc;
    rc = sdo_write_u8 (node, 0x1400u, 0x02u, 255u);                                  if (rc < 0) return rc;

    /* 2) TPDO1 매핑: 0x6041:00 (16) + 0x606C:00 (32) + 0x603F:00 (16) */
    rc = sdo_write_u8 (node, 0x1A00u, 0x00u, 0u);                                   if (rc < 0) return rc;
    rc = sdo_write_u32(node, 0x1A00u, 0x01u, MAP_ENTRY(0x6041, 0x00, 16));          if (rc < 0) return rc;
    rc = sdo_write_u32(node, 0x1A00u, 0x02u, MAP_ENTRY(0x606C, 0x00, 32));          if (rc < 0) return rc;
    rc = sdo_write_u32(node, 0x1A00u, 0x03u, MAP_ENTRY(0x603F, 0x00, 16));          if (rc < 0) return rc;
    rc = sdo_write_u8 (node, 0x1A00u, 0x00u, 3u);                                   if (rc < 0) return rc;
    /* TPDO1 통신: COB-ID=0x180+node, TT=255(비동기), EventTimer=10ms */
    rc = sdo_write_u32(node, 0x1800u, 0x01u, (uint32_t)(0x180u + (uint32_t)node));  if (rc < 0) return rc;
    rc = sdo_write_u8 (node, 0x1800u, 0x02u, 255u);                                  if (rc < 0) return rc;
    rc = sdo_write_u16(node, 0x1800u, 0x05u, 10u);                                   if (rc < 0) return rc; /* 10 ms */

    /* 3) PDO2..4는 계속 비활성 유지(0단계에서 처리됨) */
    return 0;
}

// ===== RPDO 10ms support =====
int odapp_configure_rpdo1_sync_10ms(uint8_t node)
{
    int rc = 0;
    // Disable RPDO1 while configuring (bit31=1)
    uint32_t rpdo1_disable = 0x80000000u | (0x200u + node);
    if ((rc = sdo_write_u32(node, 0x1400, 0x01, rpdo1_disable)) < 0) return rc;

    // Map only Target velocity (0x60FF:00, 32 bits)
    if ((rc = sdo_write_u8 (node, 0x1600, 0x00, 0)) < 0) return rc;
    if ((rc = sdo_write_u32(node, 0x1600, 0x01, MAP_ENTRY(0x60FF, 0x00, 32))) < 0) return rc;
    if ((rc = sdo_write_u8 (node, 0x1600, 0x00, 1)) < 0) return rc;

    // Transmission type = 1 (synchronous, each SYNC)
    if ((rc = sdo_write_u8(node, 0x1400, 0x02, 1)) < 0) return rc;

    // (Optional) Communication cycle period = 10,000 us (0x1006) — ignore failure if not supported
    (void)sdo_write_u32(node, 0x1006, 0x00, 10000u);

    // Re-enable RPDO1 with COB-ID 0x200+node
    if ((rc = sdo_write_u32(node, 0x1400, 0x01, 0x200u + node)) < 0) return rc;

    return 0;
}

int odapp_set_target_velocity_rpdo(uint8_t node, int32_t target_vel_counts_per_s)
{
    // RPDO1 mapping must be 60FF only (32-bit). Payload is 4 bytes (LE).
    uint8_t p[4];
    p[0] = (uint8_t)(target_vel_counts_per_s & 0xFF);
    p[1] = (uint8_t)((target_vel_counts_per_s >> 8) & 0xFF);
    p[2] = (uint8_t)((target_vel_counts_per_s >> 16) & 0xFF);
    p[3] = (uint8_t)((target_vel_counts_per_s >> 24) & 0xFF);
    return can_send(0x200u + node, p, 4);
}

int odapp_sync_send(void)
{
    // SYNC is an empty 0..1 byte frame on COB-ID 0x80. Use 0 bytes.
    return can_send(0x80u, NULL, 0);
}

int odapp_cycle_10ms_sync(uint8_t node, int32_t target_vel_counts_per_s)
{
    int rc = odapp_set_target_velocity_rpdo(node, target_vel_counts_per_s);
    if (rc < 0) return rc;
    return odapp_sync_send();
}


// ===== Acceleration / Deceleration (CiA-402) =====
int odapp_set_profile_accel(uint8_t node, uint32_t accel_counts_per_s2)
{
    return sdo_write_u32(node, 0x6083, 0x00, accel_counts_per_s2);
}

int odapp_set_profile_decel(uint8_t node, uint32_t decel_counts_per_s2)
{
    return sdo_write_u32(node, 0x6084, 0x00, decel_counts_per_s2);
}

int odapp_set_quick_stop_decel(uint8_t node, uint32_t qstop_counts_per_s2)
{
    return sdo_write_u32(node, 0x6085, 0x00, qstop_counts_per_s2);
}

int odapp_set_profile_accdec(uint8_t node, uint32_t accel_counts_per_s2,
                             uint32_t decel_counts_per_s2, uint32_t qstop_counts_per_s2)
{
    int rc = 0;
    if ((rc = odapp_set_profile_accel(node, accel_counts_per_s2)) < 0) return rc;
    if ((rc = odapp_set_profile_decel(node, decel_counts_per_s2)) < 0) return rc;
    if (qstop_counts_per_s2 != 0) {
        if ((rc = odapp_set_quick_stop_decel(node, qstop_counts_per_s2)) < 0) return rc;
    }
    return 0;
}


// ===== High-level startup sequence (per provided flow) =====
int odapp_set_max_torque_percent(uint8_t node, uint16_t percent_0_to_100)
{
    if (percent_0_to_100 > 100) percent_0_to_100 = 100;
    uint16_t x10 = (uint16_t)(percent_0_to_100 * 10u); // 0.1% units per CiA-402: 0..1000
    return sdo_write_u16(node, 0x6072, 0x00, x10);
}

int odapp_set_mode_profile_velocity(uint8_t node)
{
    // CiA-402: 0x6060:00 = 3 (Profile Velocity Mode)
    return sdo_write_u8(node, 0x6060, 0x00, 3);
}

int odapp_run_sequence_profile_velocity(uint8_t node,
                                        uint16_t max_torque_percent,
                                        uint32_t accel_counts_per_s2,
                                        uint32_t decel_counts_per_s2,
                                        uint32_t qstop_counts_per_s2)
{
    int rc = 0;

    // 1) NMT Reset Nodes (broadcast)
    (void)odapp_nmt_reset_node(0);
    ODAPP_DELAY_MS(50);

    // 2) NMT Start specific node
    if ((rc = odapp_nmt_start(node)) < 0) return rc;

    // 3) Max torque set
    if ((rc = odapp_set_max_torque_percent(node, max_torque_percent)) < 0) return rc;

    // 4) Operation mode = Profile Velocity
    if ((rc = odapp_set_mode_profile_velocity(node)) < 0) return rc;

    // 5) Accel/Decel (and optional Quick-Stop decel)
    if ((rc = odapp_set_profile_accdec(node, accel_counts_per_s2, decel_counts_per_s2, qstop_counts_per_s2)) < 0) return rc;

    // 6) Controlword: run (Shutdown->SwitchOn->EnableOperation)
    if ((rc = odapp_servo_enable(node)) < 0) return rc;

    ODAPP_LOG("Sequence complete (node=0x%02X, torque=%u%%, acc=%lu, dec=%lu, qstop=%lu)",
              node, (unsigned)max_torque_percent,
              (unsigned long)accel_counts_per_s2, (unsigned long)decel_counts_per_s2,
              (unsigned long)qstop_counts_per_s2);

    return 0;
}

// ===== Velocity-mode & PDO remapping =====
int odapp_configure_velocity_mode(uint8_t node)
{
    int rc = 0;

    // 0) Disable RPDO1/TPDO1 (set bit31) while reconfiguring
    uint32_t rpdo1_disable = 0x80000000u | odapp_rpdo1_cobid(node);
    uint32_t tpdo1_disable = 0x80000000u | odapp_tpdo1_cobid(node);
    if ((rc = sdo_write_u32(node, 0x1400, 0x01, rpdo1_disable)) < 0) return rc;
    if ((rc = sdo_write_u8 (node, 0x1400, 0x02, 255)) < 0) return rc; // async
    if ((rc = sdo_write_u32(node, 0x1800, 0x01, tpdo1_disable)) < 0) return rc;
    if ((rc = sdo_write_u8 (node, 0x1800, 0x02, 255)) < 0) return rc; // async

    // 1) Velocity mode
    if ((rc = sdo_write_u8(node, 0x6060, 0x00, 3)) < 0) return rc;

    // 2) RPDO1: 6040:00 (16) + 60FF:00 (32)
    if ((rc = sdo_write_u8 (node, 0x1600, 0x00, 0)) < 0) return rc;
    if ((rc = sdo_write_u32(node, 0x1600, 0x01, MAP_ENTRY(0x6040, 0x00, 16))) < 0) return rc;
    if ((rc = sdo_write_u32(node, 0x1600, 0x02, MAP_ENTRY(0x60FF, 0x00, 32))) < 0) return rc;
    if ((rc = sdo_write_u8 (node, 0x1600, 0x00, 2)) < 0) return rc;

    // 3) TPDO1: 6041:00 (16) + 606C:00 (32)
    if ((rc = sdo_write_u8 (node, 0x1A00, 0x00, 0)) < 0) return rc;
    if ((rc = sdo_write_u32(node, 0x1A00, 0x01, MAP_ENTRY(0x6041, 0x00, 16))) < 0) return rc;
    if ((rc = sdo_write_u32(node, 0x1A00, 0x02, MAP_ENTRY(0x606C, 0x00, 32))) < 0) return rc;
    if ((rc = sdo_write_u8 (node, 0x1A00, 0x00, 2)) < 0) return rc;

    // 4) Re-enable PDOs
    if ((rc = sdo_write_u32(node, 0x1400, 0x01, odapp_rpdo1_cobid(node))) < 0) return rc;
    if ((rc = sdo_write_u32(node, 0x1800, 0x01, odapp_tpdo1_cobid(node))) < 0) return rc;

    ODAPP_LOG("Velocity mode + PDO remap done for node 0x%02X", node);
    return 0;
}

int odapp_enable_operation(uint8_t node)
{
    int rc;
    if ((rc = sdo_write_u16(node, 0x6040, 0x00, 0x0006)) < 0) return rc;
    if ((rc = sdo_write_u16(node, 0x6040, 0x00, 0x0007)) < 0) return rc;
    if ((rc = sdo_write_u16(node, 0x6040, 0x00, 0x000F)) < 0) return rc;
    ODAPP_LOG("Enable Operation sequence sent (node=0x%02X)", node);
    return 0;
}

int odapp_set_profile_params(uint8_t node, uint32_t accel_cps2, uint32_t decel_cps2, uint32_t prof_vel_cps)
{
    int rc = 0;
    if (accel_cps2) if ((rc = sdo_write_u32(node, 0x6083, 0x00, accel_cps2)) < 0) return rc;
    if (decel_cps2) if ((rc = sdo_write_u32(node, 0x6084, 0x00, decel_cps2)) < 0) return rc;
    if (prof_vel_cps) if ((rc = sdo_write_u32(node, 0x6081, 0x00, prof_vel_cps)) < 0) return rc;
    return 0;
}

int odapp_set_cpr(uint8_t node, uint32_t counts_per_rev)
{
    int rc = 0;
    // Try standard CiA-402: 0x608F (encoder resolution)
    // sub1 = encoder increments; sub2 = motor revolution (keep 1)
    rc = sdo_write_u32(node, 0x608F, 0x01, counts_per_rev);
    if (rc >= 0) {
        // sub2 might be RO on some drives; ignore error
        (void)sdo_write_u32(node, 0x608F, 0x02, 1);
        ODAPP_LOG("CPR set via 0x608F to %u (node=0x%02X)", (unsigned)counts_per_rev, node);
        return 0;
    }
    // Fallback: vendor-specific (Kinco) electronic gearing under Pulse Control (0x2508)
    // sub1 Gear Factor (INTEGER16), sub2 Gear Devider (UNSIGNED16)
    // Note: clamp to 16-bit where required.
    uint32_t factor = counts_per_rev;
    if (factor > 32767u) factor = 32767u;
    rc = sdo_write_u16(node, 0x2508, 0x01, (uint16_t)factor);
    if (rc >= 0) {
        (void)sdo_write_u16(node, 0x2508, 0x02, 1);
        ODAPP_LOG("CPR set via 0x2508 (Gear Factor/Devider) to %u/1 (node=0x%02X)", (unsigned)factor, node);
        return 0;
    }
    // As a minor assist, try CiA-402 gear ratio 0x6091 = 1/1 (no scaling); not CPR but helps sanity
    (void)sdo_write_u32(node, 0x6091, 0x01, 1);
    (void)sdo_write_u32(node, 0x6091, 0x02, 1);
    return rc; // propagate last error
}

int odapp_set_velocity(uint8_t node, int32_t target_vel_counts_per_s, uint16_t controlword)
{
    uint8_t payload[8] = {0};
    payload[0] = (uint8_t)(controlword & 0xFF);
    payload[1] = (uint8_t)((controlword >> 8) & 0xFF);
    payload[2] = (uint8_t)(target_vel_counts_per_s & 0xFF);
    payload[3] = (uint8_t)((target_vel_counts_per_s >> 8) & 0xFF);
    payload[4] = (uint8_t)((target_vel_counts_per_s >> 16) & 0xFF);
    payload[5] = (uint8_t)((target_vel_counts_per_s >> 24) & 0xFF);

    uint32_t cobid = 0x200u + (uint32_t)node;
    int rc = can_send(cobid, payload, 8);
    if (rc >= 0) {
        ODAPP_LOG("RPDO1 sent (node=0x%02X, cw=0x%04X, vel=%ld cps)", node, controlword, (long)target_vel_counts_per_s);
        return 0;
    }
    return rc;
}

int odapp_parse_tpdo1(uint8_t node, uint32_t cobid, const uint8_t* data, uint8_t len,
                      uint16_t* out_status, int32_t* out_vel_actual)
{
    if (cobid != (0x180u + (uint32_t)node)) return -1;
    if (len < 6) return -2;

    uint16_t sw = (uint16_t)(data[0] | ((uint16_t)data[1] << 8));
    int32_t vel = 0;
    vel |= (int32_t)data[2];
    vel |= (int32_t)data[3] << 8;
    vel |= (int32_t)data[4] << 16;
    vel |= (int32_t)data[5] << 24;

    if (out_status) *out_status = sw;
    if (out_vel_actual) *out_vel_actual = vel;
    return 0;
}

// ===== Servo enable/disable helpers =====
int odapp_servo_enable(uint8_t node)
{
    // Reuse the robust sequence
    return odapp_enable_operation(node);
}

int odapp_servo_disable_operation(uint8_t node)
{
    // Clear "Enable Operation" (bit3); typical command is 0x0007
    int rc = sdo_write_u16(node, 0x6040, 0x00, 0x0007);
    if (rc >= 0) {
        ODAPP_LOG("Servo disable operation (node=0x%02X)", node);
        return 0;
    }
    return rc;
}

int odapp_servo_disable_voltage(uint8_t node)
{
    // Fully disable power stage; command 0x0000
    int rc = sdo_write_u16(node, 0x6040, 0x00, 0x0000);
    if (rc >= 0) {
        ODAPP_LOG("Servo disable voltage (node=0x%02X)", node);
        return 0;
    }
    return rc;
}

int odapp_servo_quick_stop(uint8_t node)
{
    // Quick stop request: clear bit2; common command 0x0002
    int rc = sdo_write_u16(node, 0x6040, 0x00, 0x0002);
    if (rc >= 0) {
        ODAPP_LOG("Servo quick stop (node=0x%02X)", node);
        return 0;
    }
    return rc;
}

int odapp_servo_set_controlword_rpdo(uint8_t node, uint16_t controlword)
{
    // Send controlword via RPDO1, with velocity=0 (safe default)
    return odapp_set_velocity(node, 0, controlword);
}


// ===== Device info / firmware version =====
int odapp_read_device_info(uint8_t node, ODAPP_DeviceInfo* out)
{
    if (!out) return -1;
    memset(out, 0, sizeof(*out));

    // Numerics (robust)
    (void)sdo_read_u32(node, 0x1000, 0x00, &out->device_type);
    uint8_t err=0; if (sdo_read_u8(node, 0x1001, 0x00, &err) >= 0) out->error_register = err;
    (void)sdo_read_u32(node, 0x1018, 0x01, &out->vendor_id);
    (void)sdo_read_u32(node, 0x1018, 0x02, &out->product_code);
    (void)sdo_read_u32(node, 0x1018, 0x03, &out->revision);
    (void)sdo_read_u32(node, 0x1018, 0x04, &out->serial);

    // Strings (best-effort expedited only)
    (void)sdo_read_string(node, 0x1008, 0x00, out->device_name, sizeof(out->device_name));
    (void)sdo_read_string(node, 0x1009, 0x00, out->hw_version, sizeof(out->hw_version));
    (void)sdo_read_string(node, 0x100A, 0x00, out->sw_version, sizeof(out->sw_version));

    return 0;
}

void odapp_print_device_info(const ODAPP_DeviceInfo* i)
{
    if (!i) return;
    printf("Device type:    0x%08lX\n", (unsigned long)i->device_type);
    printf("Error register: 0x%02X\n", (unsigned)i->error_register);
    printf("Vendor ID:      0x%08lX\n", (unsigned long)i->vendor_id);
    printf("Product code:   0x%08lX\n", (unsigned long)i->product_code);
    printf("Revision:       0x%08lX\n", (unsigned long)i->revision);
    printf("Serial:         0x%08lX\n", (unsigned long)i->serial);
    printf("Device name:    %s\n", i->device_name[0] ? i->device_name : "(n/a)");
    printf("HW version:     %s\n", i->hw_version[0] ? i->hw_version : "(n/a)");
    printf("SW version:     %s\n", i->sw_version[0] ? i->sw_version : "(n/a)");
}


// ===== EEPROM / parameter storage (CiA 301: 0x1010/0x1011) =====
int odapp_store_params(uint8_t node, odapp_store_area_t area)
{
    // "save" ASCII little-endian = 0x65766173
    uint32_t save_magic = 0x65766173u;
    uint16_t idx = 0x1010;
    uint8_t  sub = (uint8_t)area;
    return sdo_write_u32(node, idx, sub, save_magic);
}
int odapp_store_params_all(uint8_t node)  { return odapp_store_params(node, ODAPP_STORE_ALL); }
int odapp_store_params_comm(uint8_t node) { return odapp_store_params(node, ODAPP_STORE_COMM); }
int odapp_store_params_app(uint8_t node)  { return odapp_store_params(node, ODAPP_STORE_APP); }
int odapp_store_params_manu(uint8_t node) { return odapp_store_params(node, ODAPP_STORE_MANUFACTURER); }

int odapp_restore_defaults(uint8_t node, odapp_store_area_t area)
{
    // "load" ASCII little-endian = 0x64616F6Cu
    uint32_t load_magic = 0x64616F6Cu;
    uint16_t idx = 0x1011;
    uint8_t  sub = (uint8_t)area;
    return sdo_write_u32(node, idx, sub, load_magic);
}
int odapp_restore_defaults_all(uint8_t node) { return odapp_restore_defaults(node, ODAPP_STORE_ALL); }


// ===== Alarm/Fault reset & Error code parsing =====

int odapp_recover_from_fault(uint8_t node)
{
    int rc = 0;
    // 1) Fault reset
    rc = odapp_fault_reset(node);
    if (rc < 0) return rc;
    ODAPP_DELAY_MS(1);

    // 2) Optional: clear error history (best-effort)
    (void)odapp_clear_error_log(node);

    // 3) Standard DS402 sequence back to Operation Enabled
    if ((rc = sdo_write_u16(node, 0x6040, 0x00, 0x0006)) < 0) return rc; // Shutdown
    if ((rc = sdo_write_u16(node, 0x6040, 0x00, 0x0007)) < 0) return rc; // Switch On
    if ((rc = sdo_write_u16(node, 0x6040, 0x00, 0x000F)) < 0) return rc; // Enable Operation

    ODAPP_LOG("Fault recovered and Operation Enabled (node=0x%02X)", node);
    return 0;
}

int odapp_fault_reset(uint8_t node)
{
    // Pulse Fault Reset (bit7). Some drives require only the pulse, others a follow-up to 0x0006.
    int rc = sdo_write_u16(node, 0x6040, 0x00, 0x0080);
    return rc;
}

int odapp_clear_error_log(uint8_t node)
{
    // 0x1003:00 = 0 clears the error history. Ignore failure if not supported.
    int rc = sdo_write_u8(node, 0x1003, 0x00, 0);
    return rc;
}

int odapp_read_error_code(uint8_t node, uint16_t* out_code)
{
    if (!out_code) return -1;
    uint16_t code = 0;
    int rc = sdo_read_u16(node, 0x603F, 0x00, &code);
    if (rc >= 0) *out_code = code;
    return rc;
}

// Basic classification by high nibble per CiA 301
const char* odapp_error_class_str(uint16_t code)
{
    if (code == 0x0000) return "No error";
    switch (code & 0xF000) {
        case 0x1000: return "Generic";
        case 0x2000: return "Current";
        case 0x3000: return "Voltage";
        case 0x4000: return "Temperature";
        case 0x5000: return "Device hardware";
        case 0x6000: return "Device software";
        case 0x7000: return "Additional modules";
        case 0x8000: return "Monitoring";
        case 0x9000: return "External";
        case 0xF000: return "Manufacturer specific";
        default:     return "Unspecified";
    }
}

// Common 0x603F codes seen with CiA-402 drives (best-effort map)
typedef struct { uint16_t code; const char* text; } _err_map_t;
static const _err_map_t _err_map[] = {
    {0x0000, "No error"},
    {0x1000, "Generic error"},
    {0x2310, "Overcurrent"},
    {0x3210, "Overvoltage (DC link)"},
    {0x3220, "Undervoltage (DC link)"},
    {0x3310, "Overvoltage (mains)"},
    {0x4210, "Device overtemperature"},
    {0x4280, "Motor overtemperature"},
    {0x5110, "Internal hardware error"},
    {0x5280, "Internal software error"},
    {0x5400, "Memory (EEPROM/Flash) error"},
    {0x5380, "Communication error"},
    {0x6080, "Sign of life (watchdog)"},
    {0x6180, "Firmware error"},
    {0x6320, "Parameter store error"},
    {0x7121, "Position limit reached"},
    {0x7300, "Motor blocked"},
    {0x7380, "Mechanical overload"},
    {0x8110, "CAN: Bus off"},
    {0x8120, "CAN: Rx overrun"},
    {0x8130, "CAN: Tx lost arbitration"},
    {0x8210, "CAN: Passive error"},
    {0x8220, "CAN: Acknowledge error"},
    {0x8611, "PDO length error"},
};

const char* odapp_error_desc_str(uint16_t code)
{
    for (unsigned i = 0; i < sizeof(_err_map)/sizeof(_err_map[0]); ++i) {
        if (_err_map[i].code == code) return _err_map[i].text;
    }
    return "Unknown error code";
}

void odapp_print_error(uint16_t code)
{
    printf("Error 0x%04X [%s]: %s\n", code, odapp_error_class_str(code), odapp_error_desc_str(code));
}


// ===== SDO response parsing (generic) =====
int odapp_sdo_parse_response(const uint8_t* data, uint8_t len, ODAPP_SDOParsed* out)
{
    if (!data || len < 4 || !out) return -1;
    memset(out, 0, sizeof(*out));
    out->cs_raw = data[0];
    out->index = (uint16_t)(data[1] | ((uint16_t)data[2] << 8));
    out->sub = data[3];

    if (data[0] == 0x60) {
        // Download initiate response ACK
        out->type = ODAPP_SDO_RESP_DL_INIT_ACK;
        return 0;
    } else if ((data[0] & 0xE0u) == 0x40u) {
        // Upload initiate response (expedited or size-indicated)
        out->type = ODAPP_SDO_RESP_UL_INIT_ACK;
        out->expedited = (data[0] & 0x02u) ? 1u : 0u;
        out->size_indicated = (data[0] & 0x01u) ? 1u : 0u;
        out->n_unused = (data[0] >> 2) & 0x03u;
        if (out->expedited) {
            uint8_t n = out->size_indicated ? (uint8_t)(4u - out->n_unused) : 4u;
            out->data_len = n;
            for (uint8_t i = 0; i < n; ++i) out->data[i] = data[4 + i];
        }
        return 0;
    } else if (data[0] == 0x80) {
        // Abort
        out->type = ODAPP_SDO_RESP_ABORT;
        out->abort_code = (uint32_t)data[4] |
                          ((uint32_t)data[5] << 8) |
                          ((uint32_t)data[6] << 16) |
                          ((uint32_t)data[7] << 24);
        return 0;
    }

    out->type = ODAPP_SDO_RESP_UNKNOWN;
    return 0;
}

// Map common CiA-301 SDO abort codes to messages
typedef struct { uint32_t code; const char* text; } _sdo_abort_map_t;
static const _sdo_abort_map_t _sdo_abort_map[] = {
    {0x05030000u, "Toggle bit not alternated"},
    {0x05040000u, "SDO protocol timed out"},
    {0x05040001u, "Client/server command specifier invalid or unknown"},
    {0x05040002u, "Invalid block size (block mode)"},
    {0x05040003u, "Invalid sequence number (block mode)"},
    {0x05040004u, "CRC error (block mode)"},
    {0x05040005u, "Out of memory"},
    {0x06010000u, "Unsupported access to object"},
    {0x06010001u, "Attempt to read a write-only object"},
    {0x06010002u, "Attempt to write a read-only object"},
    {0x06010003u, "Object cannot be mapped to PDO"},
    {0x06010004u, "The object is not mappable to PDO at this time"},
    {0x06010005u, "General object access failure"},
    {0x06010006u, "Object access failure due to device state"},
    {0x06020000u, "Object does not exist in the dictionary"},
    {0x06040041u, "Object cannot be mapped to the PDO"},
    {0x06040042u, "Number and length of object to be mapped exceeds PDO length"},
    {0x06040043u, "General parameter incompatibility"},
    {0x06040047u, "General internal incompatibility in the device"},
    {0x06060000u, "Access failed due to hardware error"},
    {0x06070010u, "Data type does not match; length does not match"},
    {0x06070012u, "Data type does not match; length too high"},
    {0x06070013u, "Data type does not match; length too low"},
    {0x06090011u, "Sub-index does not exist"},
    {0x06090030u, "Value range exceeded"},
    {0x06090031u, "Value too high"},
    {0x06090032u, "Value too low"},
    {0x06090036u, "Maximum value is less than minimum value"},
    {0x060A0023u, "Resource not available: SDO connection"},
    {0x08000000u, "General error"},
    {0x08000020u, "Data cannot be transferred or stored to the application"},
    {0x08000021u, "Data cannot be transferred: local control"},
    {0x08000022u, "Data cannot be transferred: present device state"},
    {0x08000023u, "Object dictionary not present or dynamic generation fails"},
    {0x08000024u, "No data available"},
};

const char* odapp_sdo_abort_str(uint32_t code)
{
    for (unsigned i = 0; i < sizeof(_sdo_abort_map)/sizeof(_sdo_abort_map[0]); ++i) {
        if (_sdo_abort_map[i].code == code) return _sdo_abort_map[i].text;
    }
    return "Unknown SDO abort code";
}

void odapp_sdo_print_parsed(const ODAPP_SDOParsed* p)
{
    if (!p) return;
    switch (p->type) {
        case ODAPP_SDO_RESP_DL_INIT_ACK:
            printf("SDO Download ACK idx=0x%04X:%u\n", p->index, p->sub);
            break;
        case ODAPP_SDO_RESP_UL_INIT_ACK:
            printf("SDO Upload ACK idx=0x%04X:%u, exp=%u, size_ind=%u, len=%u\n",
                   p->index, p->sub, p->expedited, p->size_indicated, p->data_len);
            if (p->expedited && p->data_len) {
                printf("  data: ");
                for (uint8_t i = 0; i < p->data_len; ++i) printf("%02X ", p->data[i]);
                printf("\n");
            }
            break;
        case ODAPP_SDO_RESP_ABORT:
            printf("SDO Abort idx=0x%04X:%u code=0x%08lX (%s)\n",
                   p->index, p->sub, (unsigned long)p->abort_code, odapp_sdo_abort_str(p->abort_code));
            break;
        default:
            printf("SDO Unknown cs=0x%02X idx=0x%04X:%u\n", p->cs_raw, p->index, p->sub);
            break;
    }
}
